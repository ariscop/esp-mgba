## sdkconfig.defaults
```kconfig
# would like to target the esp32-c3
# so be a single-core chip
CONFIG_FREERTOS_UNICORE=y

CONFIG_ESP32_REV_MIN_1=y

# Flash config
CONFIG_PARTITION_TABLE_CUSTOM=y
CONFIG_PARTITION_TABLE_CUSTOM_FILENAME="partitions.csv"
CONFIG_PARTITION_TABLE_OFFSET=0x8000

CONFIG_ESPTOOLPY_FLASHSIZE_4MB=y
CONFIG_ESPTOOLPY_FLASHFREQ_80M=y
CONFIG_ESPTOOLPY_FLASHMODE_QIO=y

# Power saving
CONFIG_PM_ENABLE=y
CONFIG_PM_DFS_INIT_AUTO=y

CONFIG_ESP32_WIFI_IRAM_OPT=y
CONFIG_ESP_WIFI_SLP_IRAM_OPT=y

# Latency
CONFIG_SPI_SLAVE_IN_IRAM=y
CONFIG_SPI_SLAVE_ISR_IN_IRAM=y
CONFIG_UART_ISR_IN_IRAM=y
```
